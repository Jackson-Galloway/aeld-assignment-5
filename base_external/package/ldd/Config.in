## base_external/package/ldd/Config.in
```kconfig
config BR2_PACKAGE_LDD
	bool "ldd"
	depends on BR2_LINUX_KERNEL
	help
	  Builds and installs the misc-modules (hello, faulty) and scull
	  kernel modules from the Linux Device Drivers 3rd edition (LDD3)
	  example sources, used to understand Buildroot kernel-module
	  packages and out-of-tree module builds.
```
